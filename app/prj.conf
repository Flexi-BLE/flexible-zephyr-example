## CMakeLists.txt
```
cmake_minimum_required(VERSION 3.20.0)

set(ZEPHYR_TOOLCHAIN_VARIANT 0.13.2)

find_package(Zephyr REQUIRED HINTS $ENV{ZEPHYR_BASE})

project(app)

target_sources(app PRIVATE
    src/main.cpp
    src/ble/common.c
    src/ble/ble.c
    src/ble/service/info.c
    src/ble/service/current_time.c
    src/ble/service/accel.c
    src/ble/service/random.c
)
```

## Kconfig
```
menu "FelxiBLE Zephyr Example"
source "Kconfig.zephyr"

config BT_FlexiBLE_SECURITY_ENABLED
	bool "Enable security"
	default y
	select BT_SMP
	select BT_SETTINGS
	select FLASH
	select FLASH_PAGE_LAYOUT
	select FLASH_MAP
	select NVS
	select SETTINGS
	help
	  "Enable BLE security"

endmenu
```

## prj.conf
```kconfig
# CONFIG_NCS_SAMPLES_DEFAULTS=y

CONFIG_CPLUSPLUS=y
CONFIG_LIB_CPLUSPLUS=y
CONFIG_NEWLIB_LIBC=y

CONFIG_MAIN_STACK_SIZE=4096
CONFIG_SYSTEM_WORKQUEUE_STACK_SIZE=2048
CONFIG_HEAP_MEM_POOL_SIZE=2048

CONFIG_FPU=y

# ble
CONFIG_BT=y
CONFIG_BT_DEVICE_APPEARANCE=552 
CONFIG_BT_PERIPHERAL=y
CONFIG_BT_DEVICE_NAME="FlexiBLE-pre-alpha"
CONFIG_BT_SMP=y
CONFIG_BT_GATT_DM=y
CONFIG_BT_DEBUG_LOG=y
CONFIG_BT_BAS=y

# manual update of BLE connection configs
CONFIG_BT_USER_DATA_LEN_UPDATE=y
CONFIG_BT_USER_PHY_UPDATE=y
CONFIG_BT_GAP_AUTO_UPDATE_CONN_PARAMS=n

# BLE connecton updates
CONFIG_BT_BUF_ACL_RX_SIZE=251
CONFIG_BT_GATT_CLIENT=y
CONFIG_BT_ATT_PREPARE_COUNT=2
CONFIG_BT_CONN_TX_MAX=10
CONFIG_BT_L2CAP_TX_BUF_COUNT=10
CONFIG_BT_L2CAP_TX_MTU=247
CONFIG_BT_L2CAP_DYNAMIC_CHANNEL=y
CONFIG_BT_CTLR_PHY_2M=y
CONFIG_BT_CTLR_RX_BUFFERS=2
CONFIG_BT_BUF_ACL_TX_COUNT=10
CONFIG_BT_BUF_ACL_TX_SIZE=251
CONFIG_BT_CTLR_DATA_LENGTH_MAX=251

# exthub specific 
CONFIG_CONSOLE=y
CONFIG_LOG=y
CONFIG_LOG_BACKEND_UART=y

# logging
CONFIG_LOG_DEFAULT_LEVEL=4

CONFIG_LED=y
```

## src/main.cpp
```c
#include <zephyr.h>
#include <string.h>
#include <soc.h>

#include <logging/log.h>

#include <device.h>
#include <devicetree.h>
#include <drivers/gpio.h>
#include <drivers/sensor.h>
#include <sys/util.h>
#include <sys/printk.h>
#include <inttypes.h>

#include <algorithm>
#include <vector>
#include <cstdlib>

#include "ble/ble.h"
#include "ble/service/info.h"
#include <zephyr/bluetooth/services/bas.h>
#include "ble/service/accel.h"
#include "ble/service/random.h"

#include "log.h"
LOG_MODULE_REGISTER(MAIN_LOG_NAME, MAIN_LOG_LEVEL);

// get LEDs
static struct gpio_dt_spec green_led = GPIO_DT_SPEC_GET_OR(DT_ALIAS(LED1), gpios, {0});

// LED Timers
struct k_timer green_led_flasher;
int green_led_on_period_ms = 25;
int green_led_off_period_ms = 975;

void green_led_flasher_callback(struct k_timer *timer)
{
	static bool green_led_state = true;
	if (green_led_state == true)
	{
		if (green_led_on_period_ms > 0)
		{
			gpio_pin_set_dt(&green_led, true);
		}
		green_led_state = false;
		k_timer_start(&green_led_flasher, K_MSEC(green_led_on_period_ms), K_NO_WAIT);
	}
	else
	{
		gpio_pin_set_dt(&green_led, false);
		green_led_state = true;
		k_timer_start(&green_led_flasher, K_MSEC(green_led_off_period_ms), K_NO_WAIT);
	}
}

static void initialize_led(struct gpio_dt_spec led)
{
    if (led.port && !device_is_ready(led.port)) {
		LOG_ERR("LED device %s is not ready; ignoring it", led.port->name);
		led.port = NULL;
	}
	if (led.port) {
		int ret = gpio_pin_configure_dt(&led, GPIO_OUTPUT);
		if (ret != 0) {
			LOG_ERR("%d: failed to configure LED device %s pin %d", ret, led.port->name, led.pin);
			led.port = NULL;
		} else {
			LOG_INF("Set up LED at %s pin %d", led.port->name, led.pin);
		}
	}
}

void accel_entry_point(void*, void*, void*)
{
	LOG_INF("Accelerometer thread started");

    // Initialize IMU
	bool last_accel_state = accel_state_get();
	uint16_t last_accel_freq = get_accel_desired_freq();
	uint32_t accel_freq_us = 1000000 / last_accel_freq;
	
	// for simulating values
	struct sensor_value accel_x = {.val1=0};
	struct sensor_value accel_y = {.val1=10};
	struct sensor_value accel_z = {.val1=20};

	while(1)
	{
		bool accel_state = accel_state_get();

		if (last_accel_state != accel_state)
		{
			LOG_INF("Accelerometer state changed to %d", accel_state);
			last_accel_state = accel_state;
		}

		if (accel_state)
		{
			uint64_t start_ticks = k_uptime_ticks();

			// simulate accelerometer data
			accel_x.val1 += 1;
			accel_y.val1 += 1;
			accel_z.val1 += 1;

			record_accel(ble_reference_time_ms(), accel_x, accel_y, accel_z);

			uint16_t desired_freq = get_accel_desired_freq();

			if (desired_freq != last_accel_freq)
			{
				last_accel_freq = desired_freq;

				accel_freq_us = 1000000 / desired_freq;

				LOG_INF("Frequency changed to %d", desired_freq);
			}

			uint64_t end_ticks = k_uptime_ticks();
			uint32_t elapsed_us = k_ticks_to_us_near32(end_ticks - start_ticks);

			if (elapsed_us < accel_freq_us)
			{
				LOG_DBG("Accel reading took %uus. Sleeping for %uus", elapsed_us, (accel_freq_us - elapsed_us));
				k_usleep(accel_freq_us - elapsed_us);
			}
			else
			{
				LOG_WRN("Can't meet desired frequency, accel reading took %uus", elapsed_us);
				k_yield();
			}
		}
		else
		{
			k_msleep(500); // sleep longer if we're not running
		}
	}
}

#define ACCEL_STACK_SIZE 1024
#define ACCEL_PRIORITY 2

K_THREAD_DEFINE(accel_tid, ACCEL_STACK_SIZE,
                accel_entry_point, NULL, NULL, NULL,
                ACCEL_PRIORITY, 0, 0);

void random_entry_point(void*, void*, void*)
{
	LOG_INF("Random thread started");

	uint32_t last_random_reading = k_uptime_get_32();
	uint8_t random_freq_ms = 1000 / random_desired_freq_get();

	while(1)
	{
		if ( ((k_uptime_get_32() - last_random_reading) >= random_freq_ms) && (random_state_get() == 1) ) {
			last_random_reading = k_uptime_get_32();

			record_random(ble_reference_time_ms());

			random_freq_ms = 1000 / random_desired_freq_get();
		}
	}
}

#define RANDOM_STACK_SIZE 1024
#define RANDOM_PRIORITY 2

K_THREAD_DEFINE(random_tid, RANDOM_STACK_SIZE,
                random_entry_point, NULL, NULL, NULL,
                RANDOM_PRIORITY, 0, 0);


void ble_entry_point(void*, void*, void*)
{
	LOG_INF("BLE thread started");
	
	// BLE Setup
	ble_init();
	ble_ad_start();
	bt_bas_set_battery_level(100U);

    while(1)
    {
		enum BLE_STATE ble_state = get_ble_state();
		switch (ble_state)
		{
			case BLE_STATE_CONNECTED_NOT_READY:
				ble_req_config();
				green_led_on_period_ms = 250;
				green_led_off_period_ms = 750;
				break;
			case BLE_STATE_CONNECTED_READY:
				green_led_on_period_ms = 750;
				green_led_off_period_ms = 250;
				break;
			case BLE_STATE_DISCONNECTED:
				green_led_on_period_ms = 50;
				green_led_off_period_ms = 950;
				break;
		}
		k_msleep(100);
    }
}

#define BLE_STACK_SIZE 2048
#define BLE_PRIORITY 1

K_THREAD_DEFINE(ble_tid, BLE_STACK_SIZE,
                ble_entry_point, NULL, NULL, NULL,
                BLE_PRIORITY, 0, 1000);


void main(void)
{   
	LOG_INF("ExtHub initializing...");

	//Initialize green led
	initialize_led(green_led);

	k_timer_init(&green_led_flasher, green_led_flasher_callback, NULL);
	k_timer_start(&green_led_flasher, K_MSEC(500), K_NO_WAIT);

	while(1)
	{
		k_msleep(1000);
	}
}
```

## src/log.h
```c
#ifndef LOG_H
#define LOG_H

#ifdef __cplusplus
extern "C" {
#endif

#define MAIN_LOG_NAME exthub_main
#define BLE_LOG_NAME exthub_ble
#define PPG_LOG_NAME exthub_ppg

#define MAIN_LOG_LEVEL 4
#define BLE_LOG_LEVEL 4
#define PPG_LOG_LEVEL 4

#ifdef __cplusplus
}
#endif

#endif /* LOG_H */
```
